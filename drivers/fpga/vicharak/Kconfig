## drivers/fpga/vicharak/Kconfig
```kconfig
menu "Vicharak Configurattion Support FPGA"

config VICHARAK_FPGA_CONFIGURE
	bool "Vicharak read write char devices"
	help
	  Read/Write to Vicharak FPGA

endmenu
```

## drivers/vaaman/Kconfig
```kconfig
config VAAMAN_BOARDINFO
	bool "Enable VAAMAN boardinfo"
	default n
	---help---
	  Say Y here to enable VAAMAN boardinfo.
	  This option enables the VAAMAN board information.

config VAAMAN_BOARDINFO_DECRYPT
	bool "Enable VAAMAN boardinfo decryption test"
	---help---
	  Say Y here to enable VAAMAN boardinfo decryption test.
	  This option enables the VAAMAN board information decryption test.

config VAAMAN_BOARDINFO_DEBUG
	bool "Enable VAAMAN boardinfo debug"
	---help---
	  Say Y here to enable VAAMAN boardinfo debug.
	  This option enables the VAAMAN board information debug.
```
